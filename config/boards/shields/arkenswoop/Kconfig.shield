## config/boards/shields/arkenswoop/Kconfig.shield
```kconfig
# Copyright (c) 2022 Duccio Breschi
# SPDX-License-Identifier: MIT

config SHIELD_ARKENSWOOP_LEFT
    def_bool $(shields_list_contains,arkenswoop_left)

config SHIELD_ARKENSWOOP_RIGHT
    def_bool $(shields_list_contains,arkenswoop_right)
```

## config/west.yml
```yaml
manifest:
  defaults:
    revision: v0.3.0
  remotes:
    - name: zmkfirmware
      url-base: https://github.com/zmkfirmware
    - name: urob
      url-base: https://github.com/urob
    - name: gibking
      url-base: https://github.com/gibking
    - name: janpfischer
      url-base: https://github.com/janpfischer
  projects:
    - name: zmk
      remote: zmkfirmware
      import: app/west.yml
    - name: zmk-auto-layer
      remote: urob
    - name: zmk-helpers
      remote: urob
    - name: zmk-tri-state
      remote: urob
    - name: zmk-arkenswoop-module
      remote: gibking
      revision: main
    - name: zmk-dongle-screen
      remote: janpfischer
      revision: main
  self:
    path: config
```
