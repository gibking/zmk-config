#include "keys_de.h"
#define COMBO_TERM_FAST 25
#define COMBO_TERM_SLOW 50

/*                                      50 KEY MATRIX / LAYOUT MAPPING

  ╭────────────────────────────────┬───────────────────────────────╮  ╭─────────────────────────────────┬─────────────────────────────────╮
  │  0   1   2   3   4   5         │          6   7   8   9 10  11 │  │ LT5 LT4 LT3 LT2 LT1 LT0         │         RT0 RT1 RT2 RT3 RT4 RT5 │
  │ 12  13  14  15  16  17         │         18  19  20  21 22  23 │  │ LM5 LM4 LM3 LM2 LM1 LM0         │         RM0 RM1 RM2 RM3 RM4 RM5 │
  │ 24  25  26  27  28  29  30  31 │ 32  33  34  35  36  37 38  39 │  │ LB5 LB4 LB3 LB2 LB1 LB0 LF1 LF0 │ RF0 RF1 RB0 RB1 RB2 RB3 RB4 RB5 │
  ╰───────────╮ 40  41  42  43  44 │ 45  46  47  48  49 ╭──────────╯  ╰───────────╮ LH4 LH3 LH2 LH1 LH0 │ RH0 RH1 RH2 RH3 RH4 ╭───────────╯
              ╰────────────────────┴────────────────────╯                         ╰─────────────────────┴─────────────────────╯
*/
/*                              36 KEY MATRIX / LAYOUT MAPPING

  ╭────────────────────┬────────────────────╮ ╭─────────────────────┬─────────────────────╮
  │  0   1   2   3   4 │  5   6   7   8   9 │ │ LT4 LT3 LT2 LT1 LT0 │ RT0 RT1 RT2 RT3 RT4 │
  │ 10  11  12  13  14 │ 15  16  17  18  19 │ │ LM4 LM3 LM2 LM1 LM0 │ RM0 RM1 RM2 RM3 RM4 │
  │ 20  21  22  23  24 │ 25  26  27  28  29 │ │ LB4 LB3 LB2 LB1 LB0 │ RB0 RB1 RB2 RB3 RB4 │
  ╰───────╮ 30  31  32 │ 33  34  35 ╭───────╯ ╰───────╮ LH2 LH1 LH0 │ RH0 RH1 RH2 ╭───────╯
          ╰────────────┴────────────╯                 ╰─────────────┴─────────────╯             */



ZMK_COMBO(c_esc, &kp ESC, LT4 LM4, ALL, COMBO_TERM_SLOW)
ZMK_COMBO(tab, &kp TAB, LM4 LB4, ALL, COMBO_TERM_SLOW)

//SYM
ZMK_COMBO(at, &kp DE_AT, RM4 RB4, 3, COMBO_TERM_SLOW)

//BONE
ZMK_COMBO(sz_bone, &sz, RT4 RM4, 0, COMBO_TERM_SLOW)
ZMK_COMBO(q_bone, &kp Q, RM4 RB4, 0, COMBO_TERM_SLOW)

// QWERTY
ZMK_COMBO(ae, &kp DE_A_UMLAUT, RM4 RB4, 1, COMBO_TERM_SLOW)
ZMK_COMBO(ue, &kp DE_U_UMLAUT, RT4 RM4, 1, COMBO_TERM_SLOW)
ZMK_COMBO(sz, &sz, RT3 RM3, 1, COMBO_TERM_SLOW)

// COLEMAK
ZMK_COMBO(ue, &kp RA(Y), RT3 RM3, 2, COMBO_TERM_SLOW)

ZMK_BEHAVIOR(m_sch, mod_morph,
    bindings = <&m_sch_lo>, <&m_sch_up>;
    mods = <(MOD_LSFT|MOD_RSFT)>;
)
ZMK_BEHAVIOR(m_sch_lo, macro, wait-ms = <0>; tap-ms = <0>; bindings = <&kp S &kp C &kp H >; )
ZMK_BEHAVIOR(m_sch_up, macro, wait-ms = <0>; tap-ms = <0>; bindings = <&kp LS(S) &kp C &kp H >; )
ZMK_COMBO(sch, &m_sch, LM2 LB2, 2, COMBO_TERM_SLOW)